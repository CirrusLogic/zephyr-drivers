/*
 * Copyright (c) 2024 Cirrus Logic, Inc.
 * SPDX-License-Identifier: Apache-2.0
 */

/****************************************
 * PLEASE KEEP REG ADDRESSES SEQUENTIAL *
 **************************************
 */

cs40l5x@0 {
	compatible = "cirrus,cs40l5x";
	reg = <0x0>;
	status = "okay";

	reset-gpios = <&test_gpio 0 0>;
};

drv2605@1 {
	compatible = "ti,drv2605";
	reg = <0x1>;
	status = "okay";

	actuator-mode = "LRA";
};
