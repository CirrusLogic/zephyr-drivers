## drivers/audio/Kconfig.cs35l45
```kconfig
# Copyright (c) 2026 Cirrus Logic, Inc.
# SPDX-License-Identifier: Apache-2.0

config AUDIO_CODEC_CS35L45
	bool "Cirrus Logic CS35L45 codec support"
	select GPIO
	select REGULATOR
	help
	  Enable driver for CS35L45 family of smart amplifiers

config AUDIO_CODEC_CS35L45_I2C
	bool "Cirrus Logic CS35L45 I2C-based amp"
	default y
	depends on DT_HAS_CIRRUS_CS35L45_ENABLED
	select I2C
	select AUDIO_CODEC_CS35L45
	help
	  Enable driver for CS35L45 I2C-based amp.

if AUDIO_CODEC_CS35L45

config AUDIO_CODEC_CS35L45_SHELL
	bool "Custom shell for Cirrus Logic CS35L45"
	depends on SHELL
	help
	  Enable CS35L45 custom shell

endif # AUDIO_CODEC_CS35L45
```

## drivers/audio/Kconfig.cs35l56
```kconfig
# Copyright (c) 2025 Cirrus Logic, Inc.
# SPDX-License-Identifier: Apache-2.0

config AUDIO_CODEC_CS35L56
	bool "Cirrus Logic CS35L56 codec support"
	depends on DT_HAS_CIRRUS_CS35L56_ENABLED
	select I2C if $(dt_compat_on_bus,$(DT_COMPAT_CIRRUS_CS35L56),i2c)
	select GPIO
	select REGULATOR
	help
	  Enable driver for CS35L56 smart amplifier

if AUDIO_CODEC_CS35L56

config AUDIO_CODEC_CS35L56_SOUNDWIRE_ASP_ARBITRATION
	bool "CS35L56 SoundWire and ASP source arbitration"
	help
	  Enables arbitration of SoundWire and ASP audio sources where
	  the SoundWire stream has priority over the ASP stream.

endif
```

## dts/bindings/audio/cirrus,cs35l45-common.yaml
```yaml
# Copyright 2026 Cirrus Logic, Inc.
# SPDX-License-Identifier: Apache-2.0

properties:
  reset-gpios:
    type: phandle-array
    description: |
      Active-low reset input

  int-gpios:
    type: phandle-array
    description: |
      Programmable open-drain interrupt output.

  cirrus,asp-sdout-hiz-ctrl:
    type: int
    description:
      Audio serial port SDOUT Hi-Z control.
    enum: [0, 1, 2, 3]
    default: 0

  cirrus,amp-gain-pcm:
    type: string
    description:
      Amplifier analog gain
    enum:
      - 10 dBV
      - 13 dBV
      - 16 dBV
      - 19 dBV
    default: "19 dBV"
```

## dts/bindings/audio/cirrus,cs35l45-i2c.yaml
```yaml
# Copyright 2026 Cirrus Logic, Inc.
# SPDX-License-Identifier: Apache-2.0

description: Cirrus Logic CS35L45 Speaker Amplifier

compatible: "cirrus,cs35l45"

include: ["i2c-device.yaml", "cirrus,cs35l45-common.yaml"]
```

## dts/bindings/audio/cirrus,cs35l56-common.yaml
```yaml
# Copyright 2025 Cirrus Logic, Inc.
# SPDX-License-Identifier: Apache-2.0

properties:
  reset-gpios:
    type: phandle-array
    description: |
      Active low signal used to reset the device to default state.

  cirrus,preempt-config:
    type: string
    description: |
      Sets the audio source preemption priority
    enum:
      - "No preemption"
      - "SoundWire"
      - "ASP"
```
